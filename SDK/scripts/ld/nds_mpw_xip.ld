/* This file is generated by nds_ldsag (version (2016-04-13) ). */
ENTRY(_start)
SECTIONS
{
	. = 0xd08000;
    FLASH_BEGIN = .;
	.xip 	:	{ 
        *(.xip ) 
../out/mpw/standalone/obj_standalone_mpw/system_common.c.o (.text .text.*)
../out/mpw/standalone/obj_standalone_mpw/system_modem_api.c.o (.text .text.*)
../out/mpw/standalone/obj_standalone_mpw/main.c.o (.text .text.*)
../out/mpw/standalone/obj_standalone_mpw/standalone.c.o (.text .text.*)
../out/mpw/standalone/obj_standalone_mpw/tasks.c.o (.text .text.*)
../out/mpw/standalone/obj_standalone_mpw/list.c.o (.text .text.*)
../out/mpw/standalone/obj_standalone_mpw/queue.c.o (.text .text.*)
../out/mpw/standalone/obj_standalone_mpw/hal_phy_mpw.c.o (.text .text.*)
../out/mpw/standalone/obj_standalone_mpw/hal_lmac_common.c.o (.text .text.*)
../out/mpw/standalone/obj_standalone_mpw/hal_lmac_util.c.o (.text .text.*)
../out/mpw/standalone/obj_standalone_mpw/hal_lmac_ps_common.c.o (.text .text.*)
../out/mpw/standalone/obj_standalone_mpw/hal_lmac_ps_psnonpoll.c.o (.text .text.*)
../out/mpw/standalone/obj_standalone_mpw/hal_rf_mpw.c.o (.text .text.*)
../out/mpw/standalone/obj_standalone_mpw/util_cli_freertos.c.o (.text .text.*)
../out/mpw/standalone/obj_standalone_mpw/util_trace.c.o (.text .text.*)
../out/mpw/standalone/obj_standalone_mpw/util_cmd.c.o (.text .text.*)
../out/mpw/standalone/obj_standalone_mpw/util_cmd_lmac.c.o (.text .text.*)
../out/mpw/standalone/obj_standalone_mpw/util_cmd_lmac_indirect.c.o (.text .text.*)
../out/mpw/standalone/obj_standalone_mpw/util_sysbuf_queue.c.o (.text .text.*)
../out/mpw/standalone/obj_standalone_mpw/util_trace_stack.c.o (.text .text.*)
../out/mpw/standalone/obj_standalone_mpw/umac_scan.c.o (.text .text.*)
../out/mpw/standalone/obj_standalone_mpw/umac_beacon.c.o (.text .text.*)
../out/mpw/standalone/obj_standalone_mpw/umac_probe_resp.c.o (.text .text.*)
../out/mpw/standalone/obj_standalone_mpw/umac_bcn_monitor.c.o (.text .text.*)
../out/mpw/standalone/obj_standalone_mpw/config.c.o (.text .text.*)
../out/mpw/standalone/obj_standalone_mpw/umac_info.c.o (.text .text.*)
../out/mpw/standalone/obj_standalone_mpw/notify.c.o (.text .text.*)
../out/mpw/standalone/obj_standalone_mpw/bss.c.o (.text .text.*)
../out/mpw/standalone/obj_standalone_mpw/eap_register.c.o (.text .text.*)
../out/mpw/standalone/obj_standalone_mpw/common.c.o (.text .text.*)
../out/mpw/standalone/obj_standalone_mpw/wpa_debug.c.o (.text .text.*)
../out/mpw/standalone/obj_standalone_mpw/wpabuf.c.o (.text .text.*)
../out/mpw/standalone/obj_standalone_mpw/wmm_ac.c.o (.text .text.*)
../out/mpw/standalone/obj_standalone_mpw/os_freeRTOS.c.o (.text .text.*)
../out/mpw/standalone/obj_standalone_mpw/eloop_freeRTOS.c.o (.text .text.*)
../out/mpw/standalone/obj_standalone_mpw/config_nrc.c.o (.text .text.*)
../out/mpw/standalone/obj_standalone_mpw/wpa.c.o (.text .text.*)
../out/mpw/standalone/obj_standalone_mpw/preauth.c.o (.text .text.*)
../out/mpw/standalone/obj_standalone_mpw/pmksa_cache.c.o (.text .text.*)
../out/mpw/standalone/obj_standalone_mpw/peerkey.c.o (.text .text.*)
../out/mpw/standalone/obj_standalone_mpw/wpa_ie.c.o (.text .text.*)
../out/mpw/standalone/obj_standalone_mpw/wpa_common.c.o (.text .text.*)
../out/mpw/standalone/obj_standalone_mpw/l2_packet_freeRTOS.c.o (.text .text.*)
../out/mpw/standalone/obj_standalone_mpw/eapol_supp_sm.c.o (.text .text.*)
../out/mpw/standalone/obj_standalone_mpw/eap.c.o (.text .text.*)
../out/mpw/standalone/obj_standalone_mpw/eap_methods.c.o (.text .text.*)
../out/mpw/standalone/obj_standalone_mpw/ap.c.o (.text .text.*)
../out/mpw/standalone/obj_standalone_mpw/hostapd.c.o (.text .text.*)
../out/mpw/standalone/obj_standalone_mpw/wpa_auth_glue.c.o (.text .text.*)
../out/mpw/standalone/obj_standalone_mpw/utils.c.o (.text .text.*)
../out/mpw/standalone/obj_standalone_mpw/authsrv.c.o (.text .text.*)
../out/mpw/standalone/obj_standalone_mpw/ap_config.c.o (.text .text.*)
../out/mpw/standalone/obj_standalone_mpw/ip_addr.c.o (.text .text.*)
../out/mpw/standalone/obj_standalone_mpw/sta_info.c.o (.text .text.*)
../out/mpw/standalone/obj_standalone_mpw/tkip_countermeasures.c.o (.text .text.*)
../out/mpw/standalone/obj_standalone_mpw/ap_mlme.c.o (.text .text.*)
../out/mpw/standalone/obj_standalone_mpw/ieee802_1x.c.o (.text .text.*)
../out/mpw/standalone/obj_standalone_mpw/eapol_auth_sm.c.o (.text .text.*)
../out/mpw/standalone/obj_standalone_mpw/ieee802_11_auth.c.o (.text .text.*)
../out/mpw/standalone/obj_standalone_mpw/ieee802_11_shared.c.o (.text .text.*)
../out/mpw/standalone/obj_standalone_mpw/drv_callbacks.c.o (.text .text.*)
../out/mpw/standalone/obj_standalone_mpw/ap_drv_ops.c.o (.text .text.*)
../out/mpw/standalone/obj_standalone_mpw/beacon.c.o (.text .text.*)
../out/mpw/standalone/obj_standalone_mpw/bss_load.c.o (.text .text.*)
../out/mpw/standalone/obj_standalone_mpw/eap_user_db.c.o (.text .text.*)
../out/mpw/standalone/obj_standalone_mpw/neighbor_db.c.o (.text .text.*)
../out/mpw/standalone/obj_standalone_mpw/rrm.c.o (.text .text.*)
../out/mpw/standalone/obj_standalone_mpw/ieee802_11_ht.c.o (.text .text.*)
../out/mpw/standalone/obj_standalone_mpw/ctrl_iface_ap.c.o (.text .text.*)
../out/mpw/standalone/obj_standalone_mpw/eap_server.c.o (.text .text.*)
../out/mpw/standalone/obj_standalone_mpw/eap_server_identity.c.o (.text .text.*)
../out/mpw/standalone/obj_standalone_mpw/eap_server_methods.c.o (.text .text.*)
../out/mpw/standalone/obj_standalone_mpw/wmm.c.o (.text .text.*)
../out/mpw/standalone/obj_standalone_mpw/ap_list.c.o (.text .text.*)
../out/mpw/standalone/obj_standalone_mpw/ieee802_11.c.o (.text .text.*)
../out/mpw/standalone/obj_standalone_mpw/hw_features.c.o (.text .text.*)
../out/mpw/standalone/obj_standalone_mpw/dfs.c.o (.text .text.*)
../out/mpw/standalone/obj_standalone_mpw/wpa_auth.c.o (.text .text.*)
../out/mpw/standalone/obj_standalone_mpw/wpa_auth_ie.c.o (.text .text.*)
../out/mpw/standalone/obj_standalone_mpw/pmksa_cache_auth.c.o (.text .text.*)
../out/mpw/standalone/obj_standalone_mpw/crypto_internal.c.o (.text .text.*)
../out/mpw/standalone/obj_standalone_mpw/tls_none.c.o (.text .text.*)
../out/mpw/standalone/obj_standalone_mpw/aes-internal.c.o (.text .text.*)
../out/mpw/standalone/obj_standalone_mpw/aes-internal-dec.c.o (.text .text.*)
../out/mpw/standalone/obj_standalone_mpw/aes-unwrap.c.o (.text .text.*)
../out/mpw/standalone/obj_standalone_mpw/aes-wrap.c.o (.text .text.*)
../out/mpw/standalone/obj_standalone_mpw/aes-internal-enc.c.o (.text .text.*)
../out/mpw/standalone/obj_standalone_mpw/md5.c.o (.text .text.*)
../out/mpw/standalone/obj_standalone_mpw/md5-internal.c.o (.text .text.*)
../out/mpw/standalone/obj_standalone_mpw/rc4.c.o (.text .text.*)
../out/mpw/standalone/obj_standalone_mpw/ctrl_iface.c.o (.text .text.*)
../out/mpw/standalone/obj_standalone_mpw/ctrl_iface_freeRTOS.c.o (.text .text.*)
../out/mpw/standalone/obj_standalone_mpw/sme.c.o (.text .text.*)
../out/mpw/standalone/obj_standalone_mpw/ieee802_11_common.c.o (.text .text.*)
../out/mpw/standalone/obj_standalone_mpw/hw_features_common.c.o (.text .text.*)
../out/mpw/standalone/obj_standalone_mpw/eap_common.c.o (.text .text.*)
../out/mpw/standalone/obj_standalone_mpw/sha1.c.o (.text .text.*)
../out/mpw/standalone/obj_standalone_mpw/sha1-prf.c.o (.text .text.*)
../out/mpw/standalone/obj_standalone_mpw/sha1-internal.c.o (.text .text.*)
../out/mpw/standalone/obj_standalone_mpw/sha1-pbkdf2.c.o (.text .text.*)
../out/mpw/standalone/obj_standalone_mpw/driver_common.c.o (.text .text.*)
../out/mpw/standalone/obj_standalone_mpw/wpa_supplicant.c.o (.text .text.*)
../out/mpw/standalone/obj_standalone_mpw/events.c.o (.text .text.*)
../out/mpw/standalone/obj_standalone_mpw/blacklist.c.o (.text .text.*)
../out/mpw/standalone/obj_standalone_mpw/wpas_glue.c.o (.text .text.*)
../out/mpw/standalone/obj_standalone_mpw/scan.c.o (.text .text.*)
../out/mpw/standalone/obj_standalone_mpw/main_freeRTOS.c.o (.text .text.*)
../out/mpw/standalone/obj_standalone_mpw/drivers.c.o (.text .text.*)
../out/mpw/standalone/obj_standalone_mpw/driver_nrc.c.o (.text .text.*)
../out/mpw/standalone/obj_standalone_mpw/driver_nrc_scan.c.o (.text .text.*)
../out/mpw/standalone/obj_standalone_mpw/driver_nrc_tx.c.o (.text .text.*)
../out/mpw/standalone/obj_standalone_mpw/driver_nrc_rx.c.o (.text .text.*)
../out/mpw/standalone/obj_standalone_mpw/driver_nrc_debug.c.o (.text .text.*)
../out/mpw/standalone/obj_standalone_mpw/ip4.c.o (.text .text.*)
../out/mpw/standalone/obj_standalone_mpw/ip4_frag.c.o (.text .text.*)
../out/mpw/standalone/obj_standalone_mpw/ip4_addr.c.o (.text .text.*)
../out/mpw/standalone/obj_standalone_mpw/def.c.o (.text .text.*)
../out/mpw/standalone/obj_standalone_mpw/dns.c.o (.text .text.*)
../out/mpw/standalone/obj_standalone_mpw/inet_chksum.c.o (.text .text.*)
../out/mpw/standalone/obj_standalone_mpw/ip.c.o (.text .text.*)
../out/mpw/standalone/obj_standalone_mpw/stats.c.o (.text .text.*)
../out/mpw/standalone/obj_standalone_mpw/autoip.c.o (.text .text.*)
../out/mpw/standalone/obj_standalone_mpw/dhcp.c.o (.text .text.*)
../out/mpw/standalone/obj_standalone_mpw/etharp.c.o (.text .text.*)
../out/mpw/standalone/obj_standalone_mpw/icmp.c.o (.text .text.*)
../out/mpw/standalone/obj_standalone_mpw/igmp.c.o (.text .text.*)
../out/mpw/standalone/obj_standalone_mpw/raw.c.o (.text .text.*)
../out/mpw/standalone/obj_standalone_mpw/timeouts.c.o (.text .text.*)
../out/mpw/standalone/obj_standalone_mpw/sys.c.o (.text .text.*)
../out/mpw/standalone/obj_standalone_mpw/tcp.c.o (.text .text.*)
../out/mpw/standalone/obj_standalone_mpw/tcp_in.c.o (.text .text.*)
../out/mpw/standalone/obj_standalone_mpw/tcp_out.c.o (.text .text.*)
../out/mpw/standalone/obj_standalone_mpw/udp.c.o (.text .text.*)
../out/mpw/standalone/obj_standalone_mpw/mem.c.o (.text .text.*)
../out/mpw/standalone/obj_standalone_mpw/memp.c.o (.text .text.*)
../out/mpw/standalone/obj_standalone_mpw/netif.c.o (.text .text.*)
../out/mpw/standalone/obj_standalone_mpw/pbuf.c.o (.text .text.*)
../out/mpw/standalone/obj_standalone_mpw/init.c.o (.text .text.*)
../out/mpw/standalone/obj_standalone_mpw/sys_arch.c.o (.text .text.*)
../out/mpw/standalone/obj_standalone_mpw/api_lib.c.o (.text .text.*)
../out/mpw/standalone/obj_standalone_mpw/api_msg.c.o (.text .text.*)
../out/mpw/standalone/obj_standalone_mpw/err.c.o (.text .text.*)
../out/mpw/standalone/obj_standalone_mpw/sockets.c.o (.text .text.*)
../out/mpw/standalone/obj_standalone_mpw/tcpip.c.o (.text .text.*)
../out/mpw/standalone/obj_standalone_mpw/ethernet.c.o (.text .text.*)
../out/mpw/standalone/obj_standalone_mpw/netbuf.c.o (.text .text.*)
../out/mpw/standalone/obj_standalone_mpw/ping.c.o (.text .text.*)
../out/mpw/standalone/obj_standalone_mpw/lwiperf.c.o (.text .text.*)
../out/mpw/standalone/obj_standalone_mpw/dhcpserver.c.o (.text .text.*)
../out/mpw/standalone/obj_standalone_mpw/umac_wim_dispatcher.c.o (.text .text.*)
../out/mpw/standalone/obj_standalone_mpw/umac_wim_manager.c.o (.text .text.*)
../out/mpw/standalone/obj_standalone_mpw/umac_wim_builder.c.o (.text .text.*)


../out/mpw/standalone/obj_standalone_mpw/md4.c.o(.text .text.*)
../out/mpw/standalone/obj_standalone_mpw/ecp.c.o(.text .text.*)
../out/mpw/standalone/obj_standalone_mpw/chachapoly.c.o(.text .text.*)
../out/mpw/standalone/obj_standalone_mpw/blowfish.c.o(.text .text.*)
../out/mpw/standalone/obj_standalone_mpw/ssl_ticket.c.o(.text .text.*)
../out/mpw/standalone/obj_standalone_mpw/ecp_curves.c.o(.text .text.*)
../out/mpw/standalone/obj_standalone_mpw/cipher.c.o(.text .text.*)
../out/mpw/standalone/obj_standalone_mpw/pkcs11.c.o(.text .text.*)
../out/mpw/standalone/obj_standalone_mpw/pk.c.o(.text .text.*)
../out/mpw/standalone/obj_standalone_mpw/entropy_poll.c.o(.text .text.*)
../out/mpw/standalone/obj_standalone_mpw/x509write_csr.c.o(.text .text.*)
../out/mpw/standalone/obj_standalone_mpw/version_features.c.o(.text .text.*)
../out/mpw/standalone/obj_standalone_mpw/havege.c.o(.text .text.*)
../out/mpw/standalone/obj_standalone_mpw/nist_kw.c.o(.text .text.*)
../out/mpw/standalone/obj_standalone_mpw/dhm.c.o(.text .text.*)
../out/mpw/standalone/obj_standalone_mpw/rsa.c.o(.text .text.*)
../out/mpw/standalone/obj_standalone_mpw/memory_buffer_alloc.c.o(.text .text.*)
../out/mpw/standalone/obj_standalone_mpw/md.c.o(.text .text.*)
../out/mpw/standalone/obj_standalone_mpw/md_wrap.c.o(.text .text.*)
../out/mpw/standalone/obj_standalone_mpw/sha256.c.o(.text .text.*)
../out/mpw/standalone/obj_standalone_mpw/ssl_cache.c.o(.text .text.*)
../out/mpw/standalone/obj_standalone_mpw/pkwrite.c.o(.text .text.*)
../out/mpw/standalone/obj_standalone_mpw/ssl_cli.c.o(.text .text.*)
../out/mpw/standalone/obj_standalone_mpw/timing.c.o(.text .text.*)
../out/mpw/standalone/obj_standalone_mpw/asn1parse.c.o(.text .text.*)
../out/mpw/standalone/obj_standalone_mpw/padlock.c.o(.text .text.*)
../out/mpw/standalone/obj_standalone_mpw/version.c.o(.text .text.*)
../out/mpw/standalone/obj_standalone_mpw/gcm.c.o(.text .text.*)  
../out/mpw/standalone/obj_standalone_mpw/cmac.c.o(.text .text.*)  
../out/mpw/standalone/obj_standalone_mpw/md2.c.o(.text .text.*)  
../out/mpw/standalone/obj_standalone_mpw/chacha20.c.o(.text .text.*)  
../out/mpw/standalone/obj_standalone_mpw/mbedtls_md5.c.o(.text .text.*)  
../out/mpw/standalone/obj_standalone_mpw/x509_crt.c.o(.text .text.*)  
../out/mpw/standalone/obj_standalone_mpw/ecdh.c.o(.text .text.*)  
../out/mpw/standalone/obj_standalone_mpw/asn1write.c.o(.text .text.*)  
../out/mpw/standalone/obj_standalone_mpw/aria.c.o(.text .text.*)  
../out/mpw/standalone/obj_standalone_mpw/debug.c.o(.text .text.*)  
../out/mpw/standalone/obj_standalone_mpw/x509_create.c.o(.text .text.*)  
../out/mpw/standalone/obj_standalone_mpw/ecjpake.c.o(.text .text.*)  
../out/mpw/standalone/obj_standalone_mpw/oid.c.o(.text .text.*)  
../out/mpw/standalone/obj_standalone_mpw/ecdsa.c.o(.text .text.*)  
../out/mpw/standalone/obj_standalone_mpw/ssl_ciphersuites.c.o(.text .text.*)  
../out/mpw/standalone/obj_standalone_mpw/sha512.c.o(.text .text.*)  
../out/mpw/standalone/obj_standalone_mpw/base64.c.o(.text .text.*)  
../out/mpw/standalone/obj_standalone_mpw/xtea.c.o(.text .text.*)  
../out/mpw/standalone/obj_standalone_mpw/aes.c.o(.text .text.*)  
../out/mpw/standalone/obj_standalone_mpw/rsa_internal.c.o(.text .text.*)  
../out/mpw/standalone/obj_standalone_mpw/cipher_wrap.c.o(.text .text.*)  
../out/mpw/standalone/obj_standalone_mpw/arc4.c.o(.text .text.*)  
../out/mpw/standalone/obj_standalone_mpw/bignum.c.o(.text .text.*)  
../out/mpw/standalone/obj_standalone_mpw/pkparse.c.o(.text .text.*)  
../out/mpw/standalone/obj_standalone_mpw/ssl_tls.c.o(.text .text.*)  
../out/mpw/standalone/obj_standalone_mpw/ssl_srv.c.o(.text .text.*)  
../out/mpw/standalone/obj_standalone_mpw/threading.c.o(.text .text.*)  
../out/mpw/standalone/obj_standalone_mpw/x509_crl.c.o(.text .text.*)  
../out/mpw/standalone/obj_standalone_mpw/camellia.c.o(.text .text.*)  
../out/mpw/standalone/obj_standalone_mpw/hkdf.c.o(.text .text.*)  
../out/mpw/standalone/obj_standalone_mpw/x509.c.o(.text .text.*)  
../out/mpw/standalone/obj_standalone_mpw/certs.c.o(.text .text.*)  
../out/mpw/standalone/obj_standalone_mpw/pem.c.o(.text .text.*)  
../out/mpw/standalone/obj_standalone_mpw/ssl_cookie.c.o(.text .text.*)  
../out/mpw/standalone/obj_standalone_mpw/ccm.c.o(.text .text.*)  
../out/mpw/standalone/obj_standalone_mpw/poly1305.c.o(.text .text.*)  
../out/mpw/standalone/obj_standalone_mpw/mbedtls_sha1.c.o(.text .text.*)  
../out/mpw/standalone/obj_standalone_mpw/hmac_drbg.c.o(.text .text.*)  
../out/mpw/standalone/obj_standalone_mpw/des.c.o(.text .text.*)  
../out/mpw/standalone/obj_standalone_mpw/platform.c.o(.text .text.*)  
../out/mpw/standalone/obj_standalone_mpw/ctr_drbg.c.o(.text .text.*)  
../out/mpw/standalone/obj_standalone_mpw/x509write_crt.c.o(.text .text.*)  
../out/mpw/standalone/obj_standalone_mpw/pk_wrap.c.o(.text .text.*)  
../out/mpw/standalone/obj_standalone_mpw/entropy.c.o(.text .text.*)  
../out/mpw/standalone/obj_standalone_mpw/aesni.c.o(.text .text.*)  
../out/mpw/standalone/obj_standalone_mpw/pkcs12.c.o(.text .text.*)  
../out/mpw/standalone/obj_standalone_mpw/error.c.o(.text .text.*)  
../out/mpw/standalone/obj_standalone_mpw/pkcs5.c.o(.text .text.*)  
../out/mpw/standalone/obj_standalone_mpw/ripemd160.c.o(.text .text.*)  
../out/mpw/standalone/obj_standalone_mpw/platform_util.c.o(.text .text.*)  
../out/mpw/standalone/obj_standalone_mpw/x509_csr.c.o(.text .text.*)   
../out/mpw/standalone/obj_standalone_mpw/mbedtls_memory.c.o(.text .text.*)
../out/mpw/standalone/obj_standalone_mpw/trs_net_sockets.c.o(.text .text.*)
../out/mpw/standalone/obj_standalone_mpw/trs_hardware_entropy.c.o(.text .text.*)

../out/mpw/standalone/obj_standalone_mpw/mqtt_msg.c.o(.text .text.*)  
../out/mpw/standalone/obj_standalone_mpw/mqtt_outbox.c.o(.text .text.*)  
../out/mpw/standalone/obj_standalone_mpw/platform_tr6260.c.o(.text .text.*)   
../out/mpw/standalone/obj_standalone_mpw/transport_ssl.c.o(.text .text.*)
../out/mpw/standalone/obj_standalone_mpw/transport_tcp.c.o(.text .text.*)
../out/mpw/standalone/obj_standalone_mpw/transport_ws.c.o(.text .text.*)
../out/mpw/standalone/obj_standalone_mpw/transport.c.o(.text .text.*)
../out/mpw/standalone/obj_standalone_mpw/mqtt_client.c.o(.text .text.*)

../out/mpw/standalone/obj_standalone_mpw/url_parser.c.o(.text .text.*)

	    *(.rodata .rodata.* .gnu.linkonce.r.* ) 
        *(.rodata1 ) 
		KEEP(*(SORT(.at_cmd* )))
		KEEP(*(SORT(.nrc_cmd* )))
    }
    FLASH_SIZE = (. - FLASH_BEGIN);
	PROVIDE (__executable_start = 0x0);
	NDS_SAG_LMA_FLASH1 = 0x0 ;
	. = 0x00010000;
	ROM_BEGIN = .;	
	.nds32_init 	: { KEEP(*(.nds32_init )) }
	.interp 	: { *(.interp ) }
	.hash 	: { *(.hash ) }
	.dynsym 	: { *(.dynsym ) }
	.dynstr 	: { *(.dynstr ) }
	.gnu.version 	: { *(.gnu.version ) }
	.gnu.version_d 	: { *(.gnu.version_d ) }
	.gnu.version_r 	: { *(.gnu.version_r ) }
	.rel.init 	: { *(.rel.init ) }
	.rela.init 	: { *(.rela.init ) }
	.rel.text 	: { *(.rel.text .rel.text.* .rel.gnu.linkonce.t.* ) }
	.rela.text 	: { *(.rela.text .rela.text.* .rela.gnu.linkonce.t.* ) }
	.rel.fini 	: { *(.rel.fini ) }
	.rela.fini 	: { *(.rela.fini ) }
	.rel.rodata 	: { *(.rel.rodata .rel.rodata.* .rel.gnu.linkonce.r.* ) }
	.rela.rodata 	: { *(.rela.rodata .rela.rodata.* .rela.gnu.linkonce.r.* ) }
	.rel.data.rel.ro 	: { *(.rel.data.rel.ro* ) }
	.rela.data.rel.ro 	: { *(.rel.data.rel.ro* ) }
	.rel.data 	: { *(.rel.data .rel.data.* .rel.gnu.linkonce.d.* ) }
	.rela.data 	: { *(.rela.data .rela.data.* .rela.gnu.linkonce.d.* ) }
	.rel.tdata 	: { *(.rel.tdata .rel.tdata.* .rel.gnu.linkonce.td.* ) }
	.rela.tdata 	: { *(.rela.tdata .rela.tdata.* .rela.gnu.linkonce.td.* ) }
	.rel.tbss 	: { *(.rel.tbss .rel.tbss.* .rel.gnu.linkonce.tb.* ) }
	.rela.tbss 	: { *(.rela.tbss .rela.tbss.* .rela.gnu.linkonce.tb.* ) }
	.rel.ctors 	: { *(.rel.ctors ) }
	.rela.ctors 	: { *(.rela.ctors ) }
	.rel.dtors 	: { *(.rel.dtors ) }
	.rela.dtors 	: { *(.rela.dtors ) }
	.rela.dyn 	: { *(rela.dyn ) *(.rela__libc_subfreeres ) *(.rela__libc_atexit ) *(.rela__libc_thread_subfreeres ) *(.rela.init_array ) *(.rela.fini_array ) }
	.rel.got 	: { *(.rel.got ) }
	.rela.got 	: { *(.rela.got ) }
	.rel.sdata 	: { *(.rel.sdata .rel.sdata.* .rel.gnu.linkonce.s.* ) }
	.rela.sdata 	: { *(.rela.sdata .rela.sdata.* .rela.gnu.linkonce.s.* ) }
	.rel.sbss 	: { *(.rel.sbss .rel.sbss.* .rel.gnu.linkonce.sb.* ) }
	.rela.sbss 	: { *(.rela.sbss .rela.sbss.* .rela.gnu.linkonce.sb.* ) }
	.rel.sdata2 	: { *(.rel.sdata2 .rel.sdata2.* .rel.gnu.linkonce.s2.* ) }
	.rela.sdata2 	: { *(.rela.sdata2 .rela.sdata2.* .rela.gnu.linkonce.s2.* ) }
	.rel.sbss2 	: { *(.rel.sbss2 .rel.sbss2.* .rel.gnu.linkonce.sb2.* ) }
	.rela.sbss2 	: { *(.rela.sbss2 .rela.sbss2.* .rela.gnu.linkonce.sb2.* ) }
	.rel.bss 	: { *(.rel.bss .rel.bss.* .rel.gnu.linkonce.b.* ) }
	.rela.bss 	: { *(.rela.bss .rela.bss.* .rela.gnu.linkonce.b.* ) }
	.rel.plt 	: { *(.rel.plt ) }
	.rela.plt 	: { *(.rela.plt ) }
	.init 	: { KEEP(*(.init )) }
	.plt 	: { *(.plt ) }
	.text 	: { *(.text .stub .text.* .gnu.linkonce.t.* ) KEEP(*(.text.*personality* )) *(.gnu.warning ) . = ALIGN(4); }
	.fini 	: { KEEP(*(.fini )) }
	.ex9.itable 	: { *(.ex9.itable ) }
	PROVIDE (__etext = .);
	PROVIDE (_etext = .);
	PROVIDE (etext = .);
	.rodata 	: { *(.rodata .rodata.* .gnu.linkonce.r.* ) }
	.rodata1 	: { *(.rodata1 ) }
	.sdata2 	: { *(.sdata2 .sdata2.* .gnu.linkonce.s2.* ) }
	.sbss2 	: { *(.sbss2 .sbss2.* .gnu.linkonce.sb2.* ) }
	.eh_frame_hdr 	: { *(.eh_frame_hdr ) }

	/*	. = 0x200000; */
	RAM_BEGIN = .;
	. = ALIGN(0x20);
	__rw_lma_start =  LOADADDR (.eh_frame);
	__rw_vma_start = ADDR(.eh_frame);
	.eh_frame 	: 	{ KEEP(*(.eh_frame )) }
	.gcc_except_table 	: 	{ KEEP(*(.gcc_except_table )) *(.gcc_except_table.* ) }
	.tdata 	: 	{ *(.tdata .tdata.* .gnu.linkonce.td.* ) }
	. = ALIGN(4);
	PROVIDE (__preinit_array_start = .);
	.preinit_array 	: 	{ KEEP(*(.preinit_array )) }
	PROVIDE (__preinit_array_end = .);
	PROVIDE (__init_array_start = .);
	.init_array 	: 	{ KEEP(*(.init_array )) }
	PROVIDE (__init_array_end = .);
	PROVIDE (__fini_array_start = .);
	.fini_array 	: 	{ KEEP(*(.fini_array )) }
	PROVIDE (__fini_array_end = .);
	PROVIDE (__ctors_start = .);
	.ctors 	: 	{ KEEP(*crtbegin*.o(.ctors)) KEEP(*(EXCLUDE_FILE (*crtend*.o) .ctors)) KEEP(*(SORT(.ctors.* ))) KEEP(*(.ctors )) }
	PROVIDE (__ctors_end = .);
	PROVIDE (__dtors_start = .);
	.dtors 	: 	{ KEEP(*crtbegin*.o(.dtors)) KEEP(*(EXCLUDE_FILE (*crtend*.o) .dtors)) KEEP(*(SORT(.dtors.* ))) KEEP(*(.dtors )) }
	PROVIDE (__dtors_end = .);
	.jcr 	: 	{ KEEP(*(.jcr )) }
	.data.rel.ro 	: 	{ *(.data.rel.ro.local ) *(.data.rel.ro* ) }
	.dynamic 	: 	{ *(.dynamic ) }
	.data 	: 	{ *(.data .data.* .gnu.linkonce.d.* ) KEEP(*(.gnu.linkonce.d.*personality* )) SORT(CONSTRUCTORS) . = ALIGN(8); }
	.data1 	: 	{ *(.data1 ) . = ALIGN(8); }
	.got 	: 	{ *(.got.plt ) *(.got ) }
	.sdata_d 	: 	{ *(.sdata_d .sdata_d.* ) }
	.sdata_w 	: 	{ *(.sdata_w .sdata_w.* ) }
	.sdata_h 	: 	{ *(.sdata_h .sdata_h.* ) }
	.sdata_b 	: 	{ *(.sdata_b .sdata_b.* ) }
	.sdata_f 	: 	{ *(.sdata_f .sdata_f.* ) }
	. = ALIGN(4);
	_edata = .;
	ROM_SIZE = . - ROM_BEGIN;
	PROVIDE(_rom_len = ROM_SIZE);
	PROVIDE (edata = .);
	__bss_start = .;
	PROVIDE (__sbss_start = .);
	PROVIDE (___sbss_start = .);
	__rw_lma_end =  LOADADDR (.tbss);
	.tbss 	: 	{ *(.tbss .tbss.* .gnu.linkonce.tb.* ) *(.tcommon ) }
	.sbss_f 	: 	{ *(.sbss_f .sbss_f.* ) *(.scommon_f .scommon_f.* ) }
	.sbss_b 	: 	{ *(.sbss_b .sbss_b.* ) *(.scommon_b .scommon_b.* ) . = ALIGN(2); }
	.sbss_h 	: 	{ *(.sbss_h .sbss_h.* ) *(.scommon_h .scommon_h.* ) . = ALIGN(4); }
	.sbss_d 	: 	{ *(.sbss_d .sbss_d.* ) *(.scommon_d .scommon_d.* ) }
	.bss 	: 
	{
		*(.sbss_w .sbss_w.* ) *(.scommon_w .scommon_w.* ) *(.dynsbss ) *(.scommon ) . = ALIGN(8);	
		*(.dynbss ) *(.bss .bss.* .gnu.linkonce.b.* ) *(COMMON ) . = ALIGN(4); 
	}
	PROVIDE (__sbss_end = .);
	PROVIDE (___sbss_end = .);
	. = ALIGN(4);
	_end = .;
	PROVIDE (end = .);
	/* PROVIDE (_stack = 0x0020fffc); */
	PROVIDE (_stack = 0x00c07f00);
	PROVIDE (_heap1_start = .);
	PROVIDE (_heap_start = 0x00200000);
	PROVIDE (_heap2_start = 0x00c02000);
	RAM_SIZE = . - RAM_BEGIN;

	. = 0x00C00000;
	BUF_BEGIN = .;
	PROVIDE (__BUF_START = .);
	/*.buffer 	: { KEEP(*(.buffer )) }*/
	.buffer_section (NOLOAD) :
	{
		KEEP(*(.buffer))
	}
	BUF_END = .;
	BUF_SIZE = . - BUF_BEGIN;
	PROVIDE (__BUF_END = .);

	.stab	0 : { *(.stab) }
	.stabstr	0 : { *(.stabstr) }
	.stab.excl	0 : { *(.stab.excl) }
	.stab.exclstr	0 : { *(.stab.exclstr) }
	.stab.index	0 : { *(.stab.index) }
	.stab.indexstr	0 : { *(.stab.indexstr) }
	.note.nds32	0 : { *(.note.nds32) *(.note.nds32.*) }
	.comment	0 : { *(.comment) }
	.debug	0 : { *(.debug) }
	.line	0 : { *(.line) }
	.debug_srcinfo	0 : { *(.debug_srcinfo) }
	.debug_sfnames	0 : { *(.debug_sfnames) }
	.debug_aranges	0 : { *(.debug_aranges) }
	.debug_pubnames	0 : { *(.debug_pubnames) }
	.debug_info	0 : { *(.debug_info .gnu.linkonce.wi.*) }
	.debug_abbrev	0 : { *(.debug_abbrev) }
	.debug_line	0 : { *(.debug_line) }
	.debug_frame	0 : { *(.debug_frame) }
	.debug_str	0 : { *(.debug_str) }
	.debug_loc	0 : { *(.debug_loc) }
	.debug_macinfo	0 : { *(.debug_macinfo) }
	.debug_weaknames	0 : { *(.debug_weaknames) }
	.debug_funcnames	0 : { *(.debug_funcnames) }
	.debug_typenames	0 : { *(.debug_typenames) }
	.debug_varnames	0 : { *(.debug_varnames) }
}
/*ASSERT((DEFINED (_RELAX_END_) ? 0x0 : ROM_SIZE) <= 0x30000, "ROM OVERFLOW");*/
/*ASSERT((DEFINED (_RELAX_END_) ? 0x0 : RAM_SIZE) <= 0x20000, "RAM OVERFLOW");*/

ASSERT((DEFINED (_RELAX_END_) ? 0x0 : ROM_SIZE) <= 0x40000, "ROM OVERFLOW");
ASSERT((DEFINED (_RELAX_END_) ? 0x0 : RAM_SIZE) <= 0x40000, "RAM OVERFLOW");
ASSERT((DEFINED (_RELAX_END_) ? 0x0 : BUF_SIZE) <= 0x10000, "BUF OVERFLOW");
/* ASSERT(((end + _stack_size) < _stack) , "BSS exceed STACK Position"); */
