/* This file is generated by nds_ldsag (version (2016-04-13) ). */
ENTRY(_start)
SECTIONS
{
	. = 0x00C04010;
    FLASH_BEGIN = .;
	.xip 	:    {
        *(.xip )
../out/fpga/standalone/obj_standalone_fpga/system_common.c.o (.text .text.*)
../out/fpga/standalone/obj_standalone_fpga/main.c.o (.text .text.*)
../out/fpga/standalone/obj_standalone_fpga/standalone.c.o (.text .text.*)
/*
../out/fpga/standalone/obj_standalone_fpga/portISR.c.o (.text .text.*)
../out/fpga/standalone/obj_standalone_fpga/port.c.o (.text .text.*)
../out/fpga/standalone/obj_standalone_fpga/portException.c.o (.text .text.*)
../out/fpga/standalone/obj_standalone_fpga/tasks.c.o (.text .text.*)
../out/fpga/standalone/obj_standalone_fpga/list.c.o (.text .text.*)
../out/fpga/standalone/obj_standalone_fpga/queue.c.o (.text .text.*)
*/

../out/fpga/standalone/obj_standalone_fpga/util_cli_freertos.c.o (.text .text.*)
../out/fpga/standalone/obj_standalone_fpga/util_trace.c.o (.text .text.*)
../out/fpga/standalone/obj_standalone_fpga/util_cmd.c.o (.text .text.*)
../out/fpga/standalone/obj_standalone_fpga/util_sysbuf_queue.c.o (.text .text.*)
../out/fpga/standalone/obj_standalone_fpga/util_trace_stack.c.o (.text .text.*)
../out/fpga/standalone/obj_standalone_fpga/config.c.o (.text .text.*)
../out/fpga/standalone/obj_standalone_fpga/notify.c.o (.text .text.*)
../out/fpga/standalone/obj_standalone_fpga/bss.c.o (.text .text.*)
../out/fpga/standalone/obj_standalone_fpga/eap_register.c.o (.text .text.*)
../out/fpga/standalone/obj_standalone_fpga/common.c.o (.text .text.*)
../out/fpga/standalone/obj_standalone_fpga/wpa_debug.c.o (.text .text.*)
../out/fpga/standalone/obj_standalone_fpga/wpabuf.c.o (.text .text.*)
../out/fpga/standalone/obj_standalone_fpga/wmm_ac.c.o (.text .text.*)
../out/fpga/standalone/obj_standalone_fpga/os_freeRTOS.c.o (.text .text.*)
../out/fpga/standalone/obj_standalone_fpga/eloop_freeRTOS.c.o (.text .text.*)
../out/fpga/standalone/obj_standalone_fpga/config_nrc.c.o (.text .text.*)
../out/fpga/standalone/obj_standalone_fpga/wpa.c.o (.text .text.*)
../out/fpga/standalone/obj_standalone_fpga/preauth.c.o (.text .text.*)
../out/fpga/standalone/obj_standalone_fpga/pmksa_cache.c.o (.text .text.*)
../out/fpga/standalone/obj_standalone_fpga/peerkey.c.o (.text .text.*)
../out/fpga/standalone/obj_standalone_fpga/wpa_ie.c.o (.text .text.*)
../out/fpga/standalone/obj_standalone_fpga/wpa_common.c.o (.text .text.*)
../out/fpga/standalone/obj_standalone_fpga/l2_packet_freeRTOS.c.o (.text .text.*)
../out/fpga/standalone/obj_standalone_fpga/eapol_supp_sm.c.o (.text .text.*)
../out/fpga/standalone/obj_standalone_fpga/eap.c.o (.text .text.*)
../out/fpga/standalone/obj_standalone_fpga/eap_methods.c.o (.text .text.*)
../out/fpga/standalone/obj_standalone_fpga/ap.c.o (.text .text.*)
../out/fpga/standalone/obj_standalone_fpga/hostapd.c.o (.text .text.*)
../out/fpga/standalone/obj_standalone_fpga/wpa_auth_glue.c.o (.text .text.*)
../out/fpga/standalone/obj_standalone_fpga/utils.c.o (.text .text.*)
../out/fpga/standalone/obj_standalone_fpga/authsrv.c.o (.text .text.*)
../out/fpga/standalone/obj_standalone_fpga/ap_config.c.o (.text .text.*)
../out/fpga/standalone/obj_standalone_fpga/ip_addr.c.o (.text .text.*)
../out/fpga/standalone/obj_standalone_fpga/sta_info.c.o (.text .text.*)
../out/fpga/standalone/obj_standalone_fpga/tkip_countermeasures.c.o (.text .text.*)
../out/fpga/standalone/obj_standalone_fpga/ap_mlme.c.o (.text .text.*)
../out/fpga/standalone/obj_standalone_fpga/ieee802_1x.c.o (.text .text.*)
../out/fpga/standalone/obj_standalone_fpga/eapol_auth_sm.c.o (.text .text.*)
../out/fpga/standalone/obj_standalone_fpga/ieee802_11_auth.c.o (.text .text.*)
../out/fpga/standalone/obj_standalone_fpga/ieee802_11_shared.c.o (.text .text.*)
../out/fpga/standalone/obj_standalone_fpga/drv_callbacks.c.o (.text .text.*)
../out/fpga/standalone/obj_standalone_fpga/ap_drv_ops.c.o (.text .text.*)
../out/fpga/standalone/obj_standalone_fpga/beacon.c.o (.text .text.*)
../out/fpga/standalone/obj_standalone_fpga/bss_load.c.o (.text .text.*)
../out/fpga/standalone/obj_standalone_fpga/eap_user_db.c.o (.text .text.*)
../out/fpga/standalone/obj_standalone_fpga/neighbor_db.c.o (.text .text.*)
../out/fpga/standalone/obj_standalone_fpga/rrm.c.o (.text .text.*)
../out/fpga/standalone/obj_standalone_fpga/ieee802_11_ht.c.o (.text .text.*)
../out/fpga/standalone/obj_standalone_fpga/ctrl_iface_ap.c.o (.text .text.*)
../out/fpga/standalone/obj_standalone_fpga/eap_server.c.o (.text .text.*)
../out/fpga/standalone/obj_standalone_fpga/eap_server_identity.c.o (.text .text.*)
../out/fpga/standalone/obj_standalone_fpga/eap_server_methods.c.o (.text .text.*)
../out/fpga/standalone/obj_standalone_fpga/wmm.c.o (.text .text.*)
../out/fpga/standalone/obj_standalone_fpga/ap_list.c.o (.text .text.*)
../out/fpga/standalone/obj_standalone_fpga/ieee802_11.c.o (.text .text.*)
../out/fpga/standalone/obj_standalone_fpga/hw_features.c.o (.text .text.*)
../out/fpga/standalone/obj_standalone_fpga/dfs.c.o (.text .text.*)
../out/fpga/standalone/obj_standalone_fpga/wpa_auth.c.o (.text .text.*)
../out/fpga/standalone/obj_standalone_fpga/wpa_auth_ie.c.o (.text .text.*)
../out/fpga/standalone/obj_standalone_fpga/pmksa_cache_auth.c.o (.text .text.*)
../out/fpga/standalone/obj_standalone_fpga/crypto_internal.c.o (.text .text.*)
../out/fpga/standalone/obj_standalone_fpga/tls_none.c.o (.text .text.*)
../out/fpga/standalone/obj_standalone_fpga/aes-internal.c.o (.text .text.*)
../out/fpga/standalone/obj_standalone_fpga/aes-internal-dec.c.o (.text .text.*)
../out/fpga/standalone/obj_standalone_fpga/aes-unwrap.c.o (.text .text.*)
../out/fpga/standalone/obj_standalone_fpga/aes-wrap.c.o (.text .text.*)
../out/fpga/standalone/obj_standalone_fpga/aes-internal-enc.c.o (.text .text.*)
../out/fpga/standalone/obj_standalone_fpga/md5.c.o (.text .text.*)
../out/fpga/standalone/obj_standalone_fpga/md5-internal.c.o (.text .text.*)
../out/fpga/standalone/obj_standalone_fpga/rc4.c.o (.text .text.*)
../out/fpga/standalone/obj_standalone_fpga/ctrl_iface.c.o (.text .text.*)
../out/fpga/standalone/obj_standalone_fpga/ctrl_iface_freeRTOS.c.o (.text .text.*)
../out/fpga/standalone/obj_standalone_fpga/sme.c.o (.text .text.*)
../out/fpga/standalone/obj_standalone_fpga/ieee802_11_common.c.o (.text .text.*)
../out/fpga/standalone/obj_standalone_fpga/hw_features_common.c.o (.text .text.*)
../out/fpga/standalone/obj_standalone_fpga/eap_common.c.o (.text .text.*)
../out/fpga/standalone/obj_standalone_fpga/sha1.c.o (.text .text.*)
../out/fpga/standalone/obj_standalone_fpga/sha1-prf.c.o (.text .text.*)
../out/fpga/standalone/obj_standalone_fpga/sha1-internal.c.o (.text .text.*)
../out/fpga/standalone/obj_standalone_fpga/sha1-pbkdf2.c.o (.text .text.*)
../out/fpga/standalone/obj_standalone_fpga/driver_common.c.o (.text .text.*)
../out/fpga/standalone/obj_standalone_fpga/wpa_supplicant.c.o (.text .text.*)
../out/fpga/standalone/obj_standalone_fpga/events.c.o (.text .text.*)
../out/fpga/standalone/obj_standalone_fpga/blacklist.c.o (.text .text.*)
../out/fpga/standalone/obj_standalone_fpga/wpas_glue.c.o (.text .text.*)
../out/fpga/standalone/obj_standalone_fpga/scan.c.o (.text .text.*)
../out/fpga/standalone/obj_standalone_fpga/main_freeRTOS.c.o (.text .text.*)
../out/fpga/standalone/obj_standalone_fpga/drivers.c.o (.text .text.*)
../out/fpga/standalone/obj_standalone_fpga/ip4.c.o (.text .text.*)
../out/fpga/standalone/obj_standalone_fpga/ip4_frag.c.o (.text .text.*)
../out/fpga/standalone/obj_standalone_fpga/ip4_addr.c.o (.text .text.*)
../out/fpga/standalone/obj_standalone_fpga/def.c.o (.text .text.*)
../out/fpga/standalone/obj_standalone_fpga/dns.c.o (.text .text.*)
../out/fpga/standalone/obj_standalone_fpga/inet_chksum.c.o (.text .text.*)
../out/fpga/standalone/obj_standalone_fpga/ip.c.o (.text .text.*)
../out/fpga/standalone/obj_standalone_fpga/stats.c.o (.text .text.*)
../out/fpga/standalone/obj_standalone_fpga/autoip.c.o (.text .text.*)
../out/fpga/standalone/obj_standalone_fpga/dhcp.c.o (.text .text.*)
../out/fpga/standalone/obj_standalone_fpga/etharp.c.o (.text .text.*)
../out/fpga/standalone/obj_standalone_fpga/icmp.c.o (.text .text.*)
../out/fpga/standalone/obj_standalone_fpga/igmp.c.o (.text .text.*)
../out/fpga/standalone/obj_standalone_fpga/raw.c.o (.text .text.*)
../out/fpga/standalone/obj_standalone_fpga/timeouts.c.o (.text .text.*)
../out/fpga/standalone/obj_standalone_fpga/sys.c.o (.text .text.*)
../out/fpga/standalone/obj_standalone_fpga/tcp.c.o (.text .text.*)
../out/fpga/standalone/obj_standalone_fpga/tcp_in.c.o (.text .text.*)
../out/fpga/standalone/obj_standalone_fpga/tcp_out.c.o (.text .text.*)
../out/fpga/standalone/obj_standalone_fpga/udp.c.o (.text .text.*)
../out/fpga/standalone/obj_standalone_fpga/mem.c.o (.text .text.*)
../out/fpga/standalone/obj_standalone_fpga/memp.c.o (.text .text.*)
../out/fpga/standalone/obj_standalone_fpga/netif.c.o (.text .text.*)
../out/fpga/standalone/obj_standalone_fpga/pbuf.c.o (.text .text.*)
../out/fpga/standalone/obj_standalone_fpga/init.c.o (.text .text.*)
../out/fpga/standalone/obj_standalone_fpga/sys_arch.c.o (.text .text.*)
../out/fpga/standalone/obj_standalone_fpga/api_lib.c.o (.text .text.*)
../out/fpga/standalone/obj_standalone_fpga/api_msg.c.o (.text .text.*)
../out/fpga/standalone/obj_standalone_fpga/err.c.o (.text .text.*)
../out/fpga/standalone/obj_standalone_fpga/sockets.c.o (.text .text.*)
../out/fpga/standalone/obj_standalone_fpga/tcpip.c.o (.text .text.*)
../out/fpga/standalone/obj_standalone_fpga/ethernet.c.o (.text .text.*)
../out/fpga/standalone/obj_standalone_fpga/netbuf.c.o (.text .text.*)
../out/fpga/standalone/obj_standalone_fpga/ping.c.o (.text .text.*)
../out/fpga/standalone/obj_standalone_fpga/dhcpserver.c.o (.text .text.*)
../lib/libwifi.a (.text .text.*)
__etext1 = .;
__stext1 = .;
	    *(.rodata .rodata.* .gnu.linkonce.r.* )
        *(.rodata1 )
		KEEP(*(SORT(.at_cmd* )))
		KEEP(*(SORT(.nrc_cmd* )))
    }
    FLASH_SIZE = (. - FLASH_BEGIN);
	PROVIDE (__executable_start = 0x0);
	NDS_SAG_LMA_FLASH1 = 0x0 ;
	. = 0x00010000;
	ROM_BEGIN = .;
	.nds32_init 	: { KEEP(*(.nds32_init )) }
	.interp 	: { *(.interp ) }
	.hash 	: { *(.hash ) }
	.dynsym 	: { *(.dynsym ) }
	.dynstr 	: { *(.dynstr ) }
	.gnu.version 	: { *(.gnu.version ) }
	.gnu.version_d 	: { *(.gnu.version_d ) }
	.gnu.version_r 	: { *(.gnu.version_r ) }
	.rel.init 	: { *(.rel.init ) }
	.rela.init 	: { *(.rela.init ) }
	.rel.text 	: { *(.rel.text .rel.text.* .rel.gnu.linkonce.t.* ) }
	.rela.text 	: { *(.rela.text .rela.text.* .rela.gnu.linkonce.t.* ) }
	.rel.fini 	: { *(.rel.fini ) }
	.rela.fini 	: { *(.rela.fini ) }
	.rel.rodata 	: { *(.rel.rodata .rel.rodata.* .rel.gnu.linkonce.r.* ) }
	.rela.rodata 	: { *(.rela.rodata .rela.rodata.* .rela.gnu.linkonce.r.* ) }
	.rel.data.rel.ro 	: { *(.rel.data.rel.ro* ) }
	.rela.data.rel.ro 	: { *(.rel.data.rel.ro* ) }
	.rel.data 	: { *(.rel.data .rel.data.* .rel.gnu.linkonce.d.* ) }
	.rela.data 	: { *(.rela.data .rela.data.* .rela.gnu.linkonce.d.* ) }
	.rel.tdata 	: { *(.rel.tdata .rel.tdata.* .rel.gnu.linkonce.td.* ) }
	.rela.tdata 	: { *(.rela.tdata .rela.tdata.* .rela.gnu.linkonce.td.* ) }
	.rel.tbss 	: { *(.rel.tbss .rel.tbss.* .rel.gnu.linkonce.tb.* ) }
	.rela.tbss 	: { *(.rela.tbss .rela.tbss.* .rela.gnu.linkonce.tb.* ) }
	.rel.ctors 	: { *(.rel.ctors ) }
	.rela.ctors 	: { *(.rela.ctors ) }
	.rel.dtors 	: { *(.rel.dtors ) }
	.rela.dtors 	: { *(.rela.dtors ) }
	.rela.dyn 	: { *(rela.dyn ) *(.rela__libc_subfreeres ) *(.rela__libc_atexit ) *(.rela__libc_thread_subfreeres ) *(.rela.init_array ) *(.rela.fini_array ) }
	.rel.got 	: { *(.rel.got ) }
	.rela.got 	: { *(.rela.got ) }
	.rel.sdata 	: { *(.rel.sdata .rel.sdata.* .rel.gnu.linkonce.s.* ) }
	.rela.sdata 	: { *(.rela.sdata .rela.sdata.* .rela.gnu.linkonce.s.* ) }
	.rel.sbss 	: { *(.rel.sbss .rel.sbss.* .rel.gnu.linkonce.sb.* ) }
	.rela.sbss 	: { *(.rela.sbss .rela.sbss.* .rela.gnu.linkonce.sb.* ) }
	.rel.sdata2 	: { *(.rel.sdata2 .rel.sdata2.* .rel.gnu.linkonce.s2.* ) }
	.rela.sdata2 	: { *(.rela.sdata2 .rela.sdata2.* .rela.gnu.linkonce.s2.* ) }
	.rel.sbss2 	: { *(.rel.sbss2 .rel.sbss2.* .rel.gnu.linkonce.sb2.* ) }
	.rela.sbss2 	: { *(.rela.sbss2 .rela.sbss2.* .rela.gnu.linkonce.sb2.* ) }
	.rel.bss 	: { *(.rel.bss .rel.bss.* .rel.gnu.linkonce.b.* ) }
	.rela.bss 	: { *(.rela.bss .rela.bss.* .rela.gnu.linkonce.b.* ) }
	.rel.plt 	: { *(.rel.plt ) }
	.rela.plt 	: { *(.rela.plt ) }
	.init 	: { KEEP(*(.init )) }
	.plt 	: { *(.plt ) }
	.text 	: { *(.text .stub .text.* .gnu.linkonce.t.* ) KEEP(*(.text.*personality* )) *(.gnu.warning ) . = ALIGN(4); }
	.fini 	: { KEEP(*(.fini )) }
	.ex9.itable 	: { *(.ex9.itable ) }
	PROVIDE (__etext = .);
	PROVIDE (_etext = .);
	PROVIDE (etext = .);
	.rodata 	: { *(.rodata .rodata.* .gnu.linkonce.r.* ) }
	.rodata1 	: { *(.rodata1 ) }
	.sdata2 	: { *(.sdata2 .sdata2.* .gnu.linkonce.s2.* ) }
	.sbss2 	: { *(.sbss2 .sbss2.* .gnu.linkonce.sb2.* ) }
	.eh_frame_hdr 	: { *(.eh_frame_hdr ) }
	ROM_SIZE = . - ROM_BEGIN;
	. = 0x200000;
	RAM_BEGIN = .;
	. = ALIGN(0x20);
	__rw_lma_start =  LOADADDR (.eh_frame);
	__rw_vma_start = ADDR(.eh_frame);
	.eh_frame 	: AT(ALIGN(LOADADDR (.eh_frame_hdr) + SIZEOF (.eh_frame_hdr), 32))
		{ KEEP(*(.eh_frame )) }
	.gcc_except_table 	: AT(ALIGN(LOADADDR (.eh_frame) + SIZEOF (.eh_frame), ALIGNOF(.gcc_except_table)))
		{ KEEP(*(.gcc_except_table )) *(.gcc_except_table.* ) }
	.tdata 	: AT(ALIGN(LOADADDR (.gcc_except_table) + SIZEOF (.gcc_except_table), ALIGNOF(.tdata)))
		{ *(.tdata .tdata.* .gnu.linkonce.td.* ) }
	. = ALIGN(4);
	PROVIDE (__preinit_array_start = .);
	.preinit_array 	: AT(ALIGN(ALIGN(LOADADDR (.tdata) + SIZEOF (.tdata), ALIGNOF(.preinit_array)), 4))
		{ KEEP(*(.preinit_array )) }
	PROVIDE (__preinit_array_end = .);
	PROVIDE (__init_array_start = .);
	.init_array 	: AT(ALIGN(LOADADDR (.preinit_array) + SIZEOF (.preinit_array), ALIGNOF(.init_array)))
		{ KEEP(*(.init_array )) }
	PROVIDE (__init_array_end = .);
	PROVIDE (__fini_array_start = .);
	.fini_array 	: AT(ALIGN(LOADADDR (.init_array) + SIZEOF (.init_array), ALIGNOF(.fini_array)))
		{ KEEP(*(.fini_array )) }
	PROVIDE (__fini_array_end = .);
	PROVIDE (__ctors_start = .);
	.ctors 	: AT(ALIGN(LOADADDR (.fini_array) + SIZEOF (.fini_array), ALIGNOF(.ctors)))
		{ KEEP(*crtbegin*.o(.ctors)) KEEP(*(EXCLUDE_FILE (*crtend*.o) .ctors)) KEEP(*(SORT(.ctors.* ))) KEEP(*(.ctors )) }
	PROVIDE (__ctors_end = .);
	PROVIDE (__dtors_start = .);
	.dtors 	: AT(ALIGN(LOADADDR (.ctors) + SIZEOF (.ctors), ALIGNOF(.dtors)))
		{ KEEP(*crtbegin*.o(.dtors)) KEEP(*(EXCLUDE_FILE (*crtend*.o) .dtors)) KEEP(*(SORT(.dtors.* ))) KEEP(*(.dtors )) }
	PROVIDE (__dtors_end = .);
	.jcr 	: AT(ALIGN(LOADADDR (.dtors) + SIZEOF (.dtors), ALIGNOF(.jcr)))
		{ KEEP(*(.jcr )) }
	.data.rel.ro 	: AT(ALIGN(LOADADDR (.jcr) + SIZEOF (.jcr), ALIGNOF(.data.rel.ro)))
		{ *(.data.rel.ro.local ) *(.data.rel.ro* ) }
	.dynamic 	: AT(ALIGN(LOADADDR (.data.rel.ro) + SIZEOF (.data.rel.ro), ALIGNOF(.dynamic)))
		{ *(.dynamic ) }
	.data 	: AT(ALIGN(LOADADDR (.dynamic) + SIZEOF (.dynamic), ALIGNOF(.data)))
		{ *(.data .data.* .gnu.linkonce.d.* ) KEEP(*(.gnu.linkonce.d.*personality* )) SORT(CONSTRUCTORS) . = ALIGN(8); }
	.data1 	: AT(ALIGN(LOADADDR (.data) + SIZEOF (.data), ALIGNOF(.data1)))
		{ *(.data1 ) . = ALIGN(8); }
/*
	.nrc_cmd : AT(ALIGN(LOADADDR (.data1) + SIZEOF (.data1), ALIGNOF(.nrc_cmd)))
		{ KEEP(*(SORT(.nrc_cmd* ))) . = ALIGN(8); }
*/
	.got 	: AT(ALIGN(ALIGN(LOADADDR (.data1) + SIZEOF (.data1), ALIGNOF(.got)), 4))
		{ *(.got.plt ) *(.got ) }
	.sdata_d 	: AT(ALIGN(LOADADDR (.got) + SIZEOF (.got), ALIGNOF(.sdata_d)))
		{ *(.sdata_d .sdata_d.* ) }
	.sdata_w 	: AT(ALIGN(LOADADDR (.sdata_d) + SIZEOF (.sdata_d), ALIGNOF(.sdata_w)))
		{ *(.sdata_w .sdata_w.* ) }
	.sdata_h 	: AT(ALIGN(LOADADDR (.sdata_w) + SIZEOF (.sdata_w), ALIGNOF(.sdata_h)))
		{ *(.sdata_h .sdata_h.* ) }
	.sdata_b 	: AT(ALIGN(LOADADDR (.sdata_h) + SIZEOF (.sdata_h), ALIGNOF(.sdata_b)))
		{ *(.sdata_b .sdata_b.* ) }
	.sdata_f 	: AT(ALIGN(LOADADDR (.sdata_b) + SIZEOF (.sdata_b), ALIGNOF(.sdata_f)))
		{ *(.sdata_f .sdata_f.* ) }
	. = ALIGN(4);
	_edata = .;
	PROVIDE (edata = .);
	__bss_start = .;
	PROVIDE (__sbss_start = .);
	PROVIDE (___sbss_start = .);
	__rw_lma_end =  LOADADDR (.tbss);
	.tbss 	: AT(ALIGN(ALIGN(LOADADDR (.sdata_f) + SIZEOF (.sdata_f), ALIGNOF(.tbss)), 4))
		{ *(.tbss .tbss.* .gnu.linkonce.tb.* ) *(.tcommon ) }
	.sbss_f 	: AT(ALIGN(LOADADDR (.tbss) + SIZEOF (.tbss), ALIGNOF(.sbss_f)))
		{ *(.sbss_f .sbss_f.* ) *(.scommon_f .scommon_f.* ) }
	.sbss_b 	: AT(ALIGN(LOADADDR (.sbss_f) + SIZEOF (.sbss_f), ALIGNOF(.sbss_b)))
		{ *(.sbss_b .sbss_b.* ) *(.scommon_b .scommon_b.* ) . = ALIGN(2); }
	.sbss_h 	: AT(ALIGN(LOADADDR (.sbss_b) + SIZEOF (.sbss_b), ALIGNOF(.sbss_h)))
		{ *(.sbss_h .sbss_h.* ) *(.scommon_h .scommon_h.* ) . = ALIGN(4); }
	.sbss_w 	: AT(ALIGN(LOADADDR (.sbss_h) + SIZEOF (.sbss_h), ALIGNOF(.sbss_w)))
		{ *(.sbss_w .sbss_w.* ) *(.scommon_w .scommon_w.* ) *(.dynsbss ) *(.scommon ) . = ALIGN(8); }
	.sbss_d 	: AT(ALIGN(LOADADDR (.sbss_w) + SIZEOF (.sbss_w), ALIGNOF(.sbss_d)))
		{ *(.sbss_d .sbss_d.* ) *(.scommon_d .scommon_d.* ) }
	.bss 	: AT(ALIGN(LOADADDR (.sbss_d) + SIZEOF (.sbss_d), ALIGNOF(.bss)))
		{ *(.dynbss ) *(.bss .bss.* .gnu.linkonce.b.* ) *(COMMON ) . = ALIGN(4); }
	PROVIDE (__sbss_end = .);
	PROVIDE (___sbss_end = .);
	. = ALIGN(4);
	_end = .;
	PROVIDE (end = .);
	/*PROVIDE (_stack = 0x20fff8);*/
	PROVIDE (_stack = 0x00223ff8);
    PROVIDE (_stack_size = 0x80 );
	RAM_SIZE = . - RAM_BEGIN;
	
	PROVIDE (_heap1_start = .);

	. = 0x00240200;
	BUF_BEGIN = .;
	PROVIDE (__BUF_START = .);
	/*.buffer 	: { KEEP(*(.buffer )) }*/
	.buffer_section (NOLOAD) :
	{
		KEEP(*(.buffer))
	}
	BUF_END = .;
	BUF_SIZE = . - BUF_BEGIN;
	PROVIDE (__BUF_END = .);

	.stab	0 : { *(.stab) }
	.stabstr	0 : { *(.stabstr) }
	.stab.excl	0 : { *(.stab.excl) }
	.stab.exclstr	0 : { *(.stab.exclstr) }
	.stab.index	0 : { *(.stab.index) }
	.stab.indexstr	0 : { *(.stab.indexstr) }
	.note.nds32	0 : { *(.note.nds32) *(.note.nds32.*) }
	.comment	0 : { *(.comment) }
	.debug	0 : { *(.debug) }
	.line	0 : { *(.line) }
	.debug_srcinfo	0 : { *(.debug_srcinfo) }
	.debug_sfnames	0 : { *(.debug_sfnames) }
	.debug_aranges	0 : { *(.debug_aranges) }
	.debug_pubnames	0 : { *(.debug_pubnames) }
	.debug_info	0 : { *(.debug_info .gnu.linkonce.wi.*) }
	.debug_abbrev	0 : { *(.debug_abbrev) }
	.debug_line	0 : { *(.debug_line) }
	.debug_frame	0 : { *(.debug_frame) }
	.debug_str	0 : { *(.debug_str) }
	.debug_loc	0 : { *(.debug_loc) }
	.debug_macinfo	0 : { *(.debug_macinfo) }
	.debug_weaknames	0 : { *(.debug_weaknames) }
	.debug_funcnames	0 : { *(.debug_funcnames) }
	.debug_typenames	0 : { *(.debug_typenames) }
	.debug_varnames	0 : { *(.debug_varnames) }
}
/*ASSERT((DEFINED (_RELAX_END_) ? 0x0 : ROM_SIZE) <= 0x30000, "ROM OVERFLOW");*/
/*ASSERT((DEFINED (_RELAX_END_) ? 0x0 : RAM_SIZE) <= 0x20000, "RAM OVERFLOW");*/

INCLUDE "../scripts/ld/nds_rom_common.ld"

ASSERT((DEFINED (_RELAX_END_) ? 0x0 : ROM_SIZE) <= 0x40000, "ROM OVERFLOW");
ASSERT((DEFINED (_RELAX_END_) ? 0x0 : RAM_SIZE) <= 0x40000, "RAM OVERFLOW");
ASSERT((DEFINED (_RELAX_END_) ? 0x0 : BUF_SIZE) <= 0x10000, "BUF OVERFLOW");
ASSERT(((end + _stack_size) < _stack) , "BSS exceed STACK Position");
